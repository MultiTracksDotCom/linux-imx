## Documentation/devicetree/bindings/extcon/multitracks,stm32-spi-ipc.yaml
```yaml
# SPDX-License-Identifier: (GPL-2.0-only OR BSD-2-Clause)
%YAML 1.2
---
$id: http://devicetree.org/schemas/extcon/multitracks,stm32-spi-ipc.yaml#
$schema: http://devicetree.org/meta-schemas/core.yaml#

title: MultiTracks STM32 SPI IPC USB extcon provider

maintainers:
  - Samuel Morris <scmorris.dev@gmail.com>

description: |
  An SPI client that talks to an external STM32 co-processor. The STM32 reports
  USB cable/role events (disconnected, peripheral or host) for each physical USB
  port over SPI, signalled by a dedicated attention (interrupt) line.

  Each USB port is described by a child connector node that acts as an extcon
  provider (EXTCON_USB / EXTCON_USB_HOST) for the USB OTG controller wired to
  that port, allowing it to switch between host and peripheral roles.

properties:
  compatible:
    const: multitracks,stm32-spi-ipc

  reg:
    maxItems: 1

  interrupts:
    maxItems: 1
    description:
      Attention line, driven by the STM32 co-processor to signal that a new
      event packet is pending on the SPI bus.

patternProperties:
  '^connector-usb[0-9]+$':
    type: object
    description:
      A virtual USB connector exposed as an extcon provider. Reference it from
      the "extcon" property of the corresponding USB OTG controller node.

    properties:
      compatible:
        const: multitracks,stm32-usb-connector

      port-id:
        $ref: /schemas/types.yaml#/definitions/uint32
        maximum: 255
        description:
          Identifier of the USB port on the STM32 co-processor that this
          connector represents. It is matched against the "port" field of the
          incoming SPI event packet.

    required:
      - compatible
      - port-id

    additionalProperties: false

required:
  - compatible
  - reg
  - interrupts

allOf:
  - $ref: /schemas/spi/spi-peripheral-props.yaml#

unevaluatedProperties: false

examples:
  - |
    #include <dt-bindings/interrupt-controller/irq.h>

    spi {
        #address-cells = <1>;
        #size-cells = <0>;

        ipc@0 {
            compatible = "multitracks,stm32-spi-ipc";
            reg = <0>;
            spi-max-frequency = <10000000>;
            interrupt-parent = <&gpio2>;
            interrupts = <11 IRQ_TYPE_EDGE_FALLING>;

            connector-usb1 {
                compatible = "multitracks,stm32-usb-connector";
                port-id = <0>;
            };

            connector-usb2 {
                compatible = "multitracks,stm32-usb-connector";
                port-id = <1>;
            };
        };
    };
...
```

## Documentation/devicetree/bindings/spi/multitracks,spi-transport.yaml
```yaml
# SPDX-License-Identifier: GPL-2.0
%YAML 1.2
---
$id: http://devicetree.org/schemas/spi/multitracks,spi-transport.yaml#
$schema: http://devicetree.org/meta-schemas/core.yaml#

title: MultiTracks SPI transport protocol (Host role)

maintainers:
  - Michael Loh <michael@multitracks.com>

description: |
  A framed, multi-channel, ack/retry link between an i.MX SoC (Host) and an
  STM32-class client MCU (Client) over a raw SPI bus, plus a companion NRDY
  GPIO handshake line in addition to the physical SPI SCK/MOSI/MISO lines.
  See the firmware repo's firmware-common/spi-transport/docs/ProtocolSpec.md
  for the full wire protocol.

  NSS and NRDY are bound here as driver-private properties, not the
  standard "cs-gpios" -- the protocol holds NSS low continuously across a
  multi-step request/ack/clock/complete cycle, not just one SPI transfer,
  so the driver owns and drives it directly rather than letting the SPI
  core auto-toggle it per-message.

allOf:
  - $ref: /schemas/spi/spi-peripheral-props.yaml#

properties:
  compatible:
    const: multitracks,spi-transport

  reg:
    maxItems: 1

  multitracks,nss-gpios:
    maxItems: 1
    description:
      Host-driven NSS (transfer request) line, held low across the whole
      request/ack/clock/complete cycle. Always GPIO_ACTIVE_HIGH regardless
      of the physical wire's true active sense, so the driver's logical
      value always equals the literal pin level (the protocol's own
      convention is "true = pin HIGH").

  multitracks,nrdy-gpios:
    maxItems: 1
    description:
      Client-driven NRDY (ready/ack) line, read by the Host. Same
      GPIO_ACTIVE_HIGH convention as multitracks,nss-gpios.

required:
  - compatible
  - reg
  - spi-max-frequency
  - multitracks,nss-gpios
  - multitracks,nrdy-gpios

unevaluatedProperties: false

examples:
  - |
    #include <dt-bindings/gpio/gpio.h>
    spi {
        #address-cells = <1>;
        #size-cells = <0>;

        spi@0 {
            compatible = "multitracks,spi-transport";
            reg = <0>;
            spi-max-frequency = <500000>;

            multitracks,nss-gpios = <&gpio5 13 GPIO_ACTIVE_HIGH>;
            multitracks,nrdy-gpios = <&gpio4 29 GPIO_ACTIVE_HIGH>;
        };
    };

...
```
